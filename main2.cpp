#include <Arduino.h>
#include <DFMiniMp3.h>
#include <Adafruit_GFX.h>
#include <Adafruit_SSD1306.h>
#include <SPI.h>

// ----------- Pines ----------
#define PIN_VOL_UP     26
#define PIN_VOL_DOWN   25
#define PIN_NEXT       35
#define PIN_PREV       32
#define PIN_PAUSE      33

#define OLED_CLK       18
#define OLED_MOSI      23
#define OLED_DC         5
#define OLED_RESET      4
#define NUM_FRAMES 27

// ---------- OLED ------------
Adafruit_SSD1306 display(128, 64, &SPI, OLED_DC, OLED_RESET, 15);

// ---------- DFPlayer --------
class Mp3Notify;
HardwareSerial dfSerial(2);
DFMiniMp3<HardwareSerial, Mp3Notify> mp3(dfSerial);

// ---------- Variables ---------
uint8_t volume = 20;
uint16_t currentTrack = 1;
uint16_t totalTracks = 0;
bool isPaused = false;
bool needDisplayUpdate = true;

// ---- Variables para animación ----
unsigned long lastButtonTime = 0;
bool showingAnimation = false;

#define FRAME_WIDTH 48
#define FRAME_HEIGHT 48

const unsigned char PROGMEM frame1[] = {0,0,0,0,0,0,0,0,0,0,0,0,0,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0,0};

const unsigned char PROGMEM frame2[] = {0,0,0,0,0,0,0,0,0,0,0,0,0,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0,0};

const unsigned char PROGMEM frame3[] = {0,0,0,0,0,0,0,0,0,0,0,0,0,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0,0};

const unsigned char PROGMEM frame4[] = {0,0,0,0,0,0,0,0,0,0,0,0,0,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0,0};

const unsigned char PROGMEM frame5[] = {0,0,0,0,0,0,0,0,0,0,0,0,0,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0,0};

const unsigned char PROGMEM frame6[] = {0,0,0,0,0,0,0,0,0,0,0,0,0,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0,0};

const unsigned char PROGMEM frame7[] = {0,0,0,0,0,0,0,0,0,0,0,0,0,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0,0};

const unsigned char PROGMEM frame8[] = {0,0,0,0,0,0,0,0,0,0,0,0,0,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0,0};

const unsigned char PROGMEM frame9[] = {0,0,0,0,0,0,0,0,0,0,0,0,0,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0,0};

const unsigned char PROGMEM frame10[] = {0,0,0,0,0,0,0,0,0,0,0,0,0,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0,0};

const unsigned char PROGMEM frame11[] = {0,0,0,0,0,0,0,0,0,0,0,0,0,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0,0};

const unsigned char PROGMEM frame12[] = {0,0,0,0,0,0,0,0,0,0,0,0,0,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0,0};

const unsigned char PROGMEM frame13[] = {0,0,0,0,0,0,0,0,0,0,0,0,0,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0,0};

const unsigned char PROGMEM frame14[] = {0,0,0,0,0,0,0,0,0,0,0,0,0,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0,0};

const unsigned char PROGMEM frame15[] = {0,0,0,0,0,0,0,0,0,0,0,0,0,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0,0};

const unsigned char PROGMEM frame16[] = {0,0,0,0,0,0,0,0,0,0,0,0,0,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0,0};

const unsigned char PROGMEM frame17[] = {0,0,0,0,0,0,0,0,0,0,0,0,0,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0,0};

const unsigned char PROGMEM frame18[] = {0,0,0,0,0,0,0,0,0,0,0,0,0,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0,0};

const unsigned char PROGMEM frame19[] = {0,0,0,0,0,0,0,0,0,0,0,0,0,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0,0};

const unsigned char PROGMEM frame20[] = {0,0,0,0,0,0,0,0,0,0,0,0,0,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0,0};

const unsigned char PROGMEM frame21[] = {0,0,0,0,0,0,0,0,0,0,0,0,0,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0,0};

const unsigned char PROGMEM frame22[] = {0,0,0,0,0,0,0,0,0,0,0,0,0,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0,0};

const unsigned char PROGMEM frame23[] = {0,0,0,0,0,0,0,0,0,0,0,0,0,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0,0};

const unsigned char PROGMEM frame24[] = {0,0,0,0,0,0,0,0,0,0,0,0,0,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0,0};

const unsigned char PROGMEM frame25[] = {0,0,0,0,0,0,0,0,0,0,0,0,0,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0,0};

const unsigned char PROGMEM frame26[] = {0,0,0,0,0,0,0,0,0,0,0,0,0,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0,0};

const unsigned char PROGMEM frame27[] = {0,0,0,0,0,0,0,0,0,0,0,0,0,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0,0};

const unsigned char* frames[] = {frame1, frame2, frame3, frame4, frame5, frame6, frame7, frame8, frame9, frame10, frame11, frame12, frame13, frame14, frame15, frame16, frame17,
frame18, frame19, frame20, frame21, frame22, frame23, frame24, frame25, frame26, frame27};


// --- Función para mostrar animación ---
  void showAnimation() {
    Serial.println("Mostrando animacion...");
    showingAnimation = true;
    int frame = 0;

    while (millis() - lastButtonTime >= 5000) {
      display.clearDisplay();
      display.drawBitmap(56, 24, frames[frame], FRAME_WIDTH, FRAME_HEIGHT, WHITE);
      display.display();
      frame = (frame + 1) % 2;
      vTaskDelay(300 / portTICK_PERIOD_MS);
    }

    Serial.println("Animacion terminada");
    showingAnimation = false;
    needDisplayUpdate = true;
  }


  // --- Nueva tarea para la animación ---
  #define X_POS ((128-FRAME_WIDTH)/2)
#define Y_POS ((64-FRAME_HEIGHT)/2)

void taskAnimation(void *param) {
  for (;;) {
    if (!showingAnimation && (millis() - lastButtonTime >= 5000)) {
      showingAnimation = true;
    }

    if (showingAnimation) {
      for (int frame = 0; frame < NUM_FRAMES; frame++) {
        display.clearDisplay();  // 🔹 Borra toda la pantalla

        // Dibuja el frame centrado
        display.drawBitmap(X_POS, Y_POS, frames[frame], FRAME_WIDTH, FRAME_HEIGHT, WHITE);
        display.display();

        vTaskDelay(40 / portTICK_PERIOD_MS);  // 25 FPS aprox

        // Si se presiona un botón, salir
        if (millis() - lastButtonTime < 5000) {
          showingAnimation = false;
          needDisplayUpdate = true;
          break;
        }
      }

      showingAnimation = false;
      needDisplayUpdate = true;
    }

    vTaskDelay(10 / portTICK_PERIOD_MS);
  }
}



// ---------- Notificaciones ----
class Mp3Notify {
public:
  static void OnError(DFMiniMp3<HardwareSerial, Mp3Notify>&, uint16_t) {}

  static void OnPlayFinished(DFMiniMp3<HardwareSerial, Mp3Notify>& mp3, DfMp3_PlaySources, uint16_t) {
    currentTrack++;
    if (currentTrack > totalTracks) currentTrack = 1;
    mp3.playMp3FolderTrack(currentTrack);
    needDisplayUpdate = true;
  }

  static void OnPlaySourceOnline(DFMiniMp3<HardwareSerial, Mp3Notify>&, DfMp3_PlaySources) {}
  static void OnPlaySourceInserted(DFMiniMp3<HardwareSerial, Mp3Notify>&, DfMp3_PlaySources) {}
  static void OnPlaySourceRemoved(DFMiniMp3<HardwareSerial, Mp3Notify>&, DfMp3_PlaySources) {}
};

// ---------- Función para mostrar OLED ---------
void updateDisplay() {
  // 🔹 Evitar parpadeo: solo limpiar si no venimos de animación
  if (!showingAnimation) {
    display.clearDisplay();
  }

  // TRACK
  display.setTextSize(2);
  display.setCursor(0, 0);
  display.print("Track: ");
  display.print(currentTrack);
  display.print("/");
  display.println(totalTracks);

  // VOLUMEN
  display.setCursor(0, 32);
  display.print("Vol: ");
  display.println(volume);

  // ESTADO
  display.setTextSize(1);
  const char* estado = isPaused ? "Pause" : "Play";

  int16_t x, y;
  uint16_t w, h;
  display.getTextBounds(estado, 0, 0, &x, &y, &w, &h);
  int posX = (128 - w) / 2;
  int posY = 54;

  display.setCursor(posX, posY);
  display.print(estado);

  display.display();
}


// ---------- Tareas FreeRTOS ------------

void taskButtons(void *param) {
  bool lastNext = HIGH, lastPrev = HIGH, lastPause = HIGH;
  for (;;) {
    bool nowNext = digitalRead(PIN_NEXT);
    bool nowPrev = digitalRead(PIN_PREV);
    bool nowPause = digitalRead(PIN_PAUSE);

    // Detecta cambio a presionado
    if ((lastNext == HIGH && nowNext == LOW) || 
        (lastPrev == HIGH && nowPrev == LOW) || 
        (lastPause == HIGH && nowPause == LOW)) {

      lastButtonTime = millis();  // Solo actualiza cuando se presiona un botón

      if (showingAnimation) {
        showingAnimation = false;
        needDisplayUpdate = true;
      }
    }

    // Maneja cada botón
    if (lastNext == HIGH && nowNext == LOW) {
      currentTrack++;
      if (currentTrack > totalTracks) currentTrack = 1;
      mp3.playMp3FolderTrack(currentTrack);
      needDisplayUpdate = true;
    }
    if (lastPrev == HIGH && nowPrev == LOW) {
      currentTrack = (currentTrack <= 1) ? totalTracks : currentTrack - 1;
      mp3.playMp3FolderTrack(currentTrack);
      needDisplayUpdate = true;
    }
    if (lastPause == HIGH && nowPause == LOW) {
      isPaused = !isPaused;
      isPaused ? mp3.pause() : mp3.start();
      needDisplayUpdate = true;
    }

    lastNext = nowNext;
    lastPrev = nowPrev;
    lastPause = nowPause;

    vTaskDelay(50 / portTICK_PERIOD_MS);
  }
}


void taskVolume(void *param) {
  bool lastUp = HIGH, lastDown = HIGH;
  for (;;) {
    bool nowUp = digitalRead(PIN_VOL_UP);
    bool nowDown = digitalRead(PIN_VOL_DOWN);

    if (lastUp == HIGH && nowUp == LOW && volume < 30) {
      volume++;
      mp3.setVolume(volume);
      needDisplayUpdate = true;
      lastButtonTime = millis();  // Actualiza aquí al subir volumen
      if (showingAnimation) {
        showingAnimation = false;
        needDisplayUpdate = true;
      }
    }
    if (lastDown == HIGH && nowDown == LOW && volume > 0) {
      volume--;
      mp3.setVolume(volume);
      needDisplayUpdate = true;
      lastButtonTime = millis();  // Actualiza aquí al bajar volumen
      if (showingAnimation) {
        showingAnimation = false;
        needDisplayUpdate = true;
      }
    }

    lastUp = nowUp;
    lastDown = nowDown;

    vTaskDelay(100 / portTICK_PERIOD_MS);
  }
}

void taskDisplayUpdate(void *param) {
  for (;;) {
    if (!showingAnimation && needDisplayUpdate) {  
      updateDisplay();
      needDisplayUpdate = false;
    }
    vTaskDelay(50 / portTICK_PERIOD_MS);
  }
}

void taskDFPlayerLoop(void *param) {
  for (;;) {
    mp3.loop();
    vTaskDelay(50 / portTICK_PERIOD_MS);
  }
}


void taskSerialControl(void *param) {
  String input = "";
  for (;;) {
    while (Serial.available()) {
      char c = Serial.read();
      if (c == '\n' || c == '\r') {
        input.trim();
        if (input.equalsIgnoreCase("on")) {
          if (isPaused) {
            isPaused = false;
            mp3.start();
            needDisplayUpdate = true;
          }
        } else if (input.equalsIgnoreCase("off")) {
          if (!isPaused) {
            isPaused = true;
            mp3.pause();
            needDisplayUpdate = true;
          }
        }
        input = "";
      } else {
        input += c;
      }
    }
    vTaskDelay(100 / portTICK_PERIOD_MS);
  }
}


// ------------ Setup -------------
void setup() {
  Serial.begin(115200);

  pinMode(PIN_NEXT, INPUT_PULLUP);
  pinMode(PIN_PREV, INPUT_PULLUP);
  pinMode(PIN_PAUSE, INPUT_PULLUP);
  pinMode(PIN_VOL_UP, INPUT_PULLUP);
  pinMode(PIN_VOL_DOWN, INPUT_PULLUP);

 if (!display.begin(SSD1306_SWITCHCAPVCC)) {
  while (1);  
  }
  display.setTextColor(WHITE);

  dfSerial.begin(9600, SERIAL_8N1, 16, 17);
  mp3.begin();
  delay(500);

  totalTracks = mp3.getTotalTrackCount();
  if (totalTracks == 0) totalTracks = 1;

  mp3.setVolume(volume);
  mp3.playMp3FolderTrack(currentTrack);

  updateDisplay();

  xTaskCreatePinnedToCore(taskSerialControl, "SerialCtrl", 2048, NULL, 1, NULL, 1);
  xTaskCreatePinnedToCore(taskButtons, "Buttons", 2048, NULL, 1, NULL, 1);
  xTaskCreatePinnedToCore(taskVolume, "Volume", 2048, NULL, 1, NULL, 1);
  xTaskCreatePinnedToCore(taskDisplayUpdate, "Display", 2048, NULL, 1, NULL, 1);
  xTaskCreatePinnedToCore(taskDFPlayerLoop, "DFPlayer", 2048, NULL, 1, NULL, 1);
  xTaskCreatePinnedToCore(taskAnimation, "Animation", 2048, NULL, 1, NULL, 1);

}

void loop() {
  
}
